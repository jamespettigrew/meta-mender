## meta-mender-nanopi/conf/layer.conf
```bitbake
# Board specific layer configuration for meta-mender
# Copyright 2017 Innovum Controls Pty Ltd.

# We have a conf and classes directory, add to BBPATH
BBPATH .= ":${LAYERDIR}"

# We have recipes-* directories, add to BBFILES
BBFILES += "${LAYERDIR}/recipes-*/*/*.bb \
	${LAYERDIR}/recipes-*/*/*.bbappend"

BBFILE_COLLECTIONS += "mender-nanopi"
BBFILE_PATTERN_mender-nanopi = "^${LAYERDIR}/"
BBFILE_PRIORITY_mender-nanopi = "11"
```
